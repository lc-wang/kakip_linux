// SPDX-License-Identifier: (GPL-2.0-only OR BSD-2-Clause)
/*
 * Device Tree Source for the Kakip ES 1 board
 *
 * Copyright (C) 2024 AMATAMA Co.
 */

/dts-v1/;

#include "kakip-es1.dts"

&ddr0 {
	device_type = "memory";
	/* first 128MB is reserved for secure area. */
	reg = <0x0 0x48000000 0x0 0xF8000000>;
};


&eth0 {
	phy-handle = <&phy0>;
	phy-mode = "rgmii-id";
	status = "okay";

	mdio {
		#address-cells = <1>;
		#size-cells = <0>;
		phy0: ethernet-phy@0 {
			compatible = "ethernet-phy-id0022.1640",
				     "ethernet-phy-ieee802.3-c22";
			reg = <0>;
			rxc-skew-psec = <1400>;
			txc-skew-psec = <1400>;
			rxdv-skew-psec = <0>;
			txdv-skew-psec = <0>;
			rxd0-skew-psec = <0>;
			rxd1-skew-psec = <0>;
			rxd2-skew-psec = <0>;
			rxd3-skew-psec = <0>;
			txd0-skew-psec = <0>;
			txd1-skew-psec = <0>;
			txd2-skew-psec = <0>;
			txd3-skew-psec = <0>;
		};
	};
};
