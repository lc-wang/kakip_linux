/dts-v1/;
/plugin/;

#include <dt-bindings/pinctrl/rzg2l-pinctrl.h>
#include <dt-bindings/gpio/gpio.h>

/ {
	fragment@0 {
		target = <&pinctrl>;
		__overlay__ {
			spi0_pins: spi0 {
				pinmux = <RZG2L_PORT_PINMUX(9, 1, 1)>,
					<RZG2L_PORT_PINMUX(9, 0, 1)>,
					<RZG2L_PORT_PINMUX(9, 2, 1)>,
					<RZG2L_PORT_PINMUX(9, 3, 1)>,
					<RZG2L_PORT_PINMUX(9, 4, 1)>;
			};
		};
	};

	fragment@1 {
		target = <&spi0>;
		__overlay__ {
			pinctrl-0 = <&spi0_pins>;
			pinctrl-names = "default";
			status = "okay";
			#address-cells = <1>;
			#size-cells = <0>;
			spi_dev0: spi@0 {
				compatible = "rohm,dh2228fv";
				pl022,com-mode = <1>;
				spi-max-frequency = <10000000>;
				reg = <0>;
				status = "okay";
			};
		};
	};
};

